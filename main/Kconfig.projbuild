## main/Kconfig.projbuild
```kconfig
menu "Example Configuration"

    orsource "$IDF_PATH/examples/common_components/env_caps/$IDF_TARGET/Kconfig.env_caps"

    config HW_VARIANT
        string "Hardware variant"
        default "custom"
        help
            Any hardware with the same HW_VARIANT is assumed to be binary compatible and can receive OTA updates.
            If you set this to "custom", this means that the hardware is not binary compatible with any other known
            hardware, and you will not receive (potentially incompatible) OTA updates.

    config ENABLE_SD
        bool "Enable SD card"
        default y
        help
            General toggle for enabling/disabling SD card related functionality.

    config SNIFFER_STORE_HISTORY
        bool "Store command history into flash"
        default y
        help
            Linenoise line editing library provides functions to save and load command history.
            If this option is enabled, initializes a FAT filesystem and uses it to store command history.

    choice SNIFFER_PCAP_DESTINATION
        prompt "Select destination to store pcap file"
        default SNIFFER_PCAP_DESTINATION_SD
        help
            Select where to store the pcap file.
            Currently support storing files to SD card or to host via JTAG interface with 'Trace memory' enabled.
        config SNIFFER_PCAP_DESTINATION_SD
            bool "SD Card"
            depends on ENABLE_SD
            help
                Store pcap file to SD card.
        config SNIFFER_PCAP_DESTINATION_JTAG
            bool "JTAG (App Trace)"
            depends on APPTRACE_DEST_JTAG
            help
                Store pcap file to host via JTAG interface.
        config SNIFFER_PCAP_DESTINATION_MEMORY
            bool "Memory"
            help
                Store pcap file to memory.
    endchoice

    if ENABLE_SD
        choice SNIFFER_SD_MODE
            prompt "Select SD card work mode"
            default SNIFFER_SD_SDMMC_MODE
            help
                Select which peripheral SD card should use.
            config SNIFFER_SD_SDMMC_MODE
                bool "SDMMC"
                depends on SOC_SDMMC_HOST_SUPPORTED
                help
                    Use SDMMC mode (Not support on esp32c3).
            config SNIFFER_SD_SPI_MODE
                bool "SPI"
                help
                    Use SPI mode.
        endchoice
        menu "SD card pin configuration (SPI)"
            depends on SNIFFER_SD_SPI_MODE

            config SNIFFER_PIN_MOSI
                int "MOSI GPIO number"
                range ENV_GPIO_RANGE_MIN ENV_GPIO_OUT_RANGE_MAX
                default 7
                help
                    GPIO pin number for SPI MOSI (Master Out Slave In).

            config SNIFFER_PIN_MISO
                int "MISO GPIO number"
                range ENV_GPIO_RANGE_MIN ENV_GPIO_IN_RANGE_MAX
                default 2
                help
                    GPIO pin number for SPI MISO (Master In Slave Out).

            config SNIFFER_PIN_CLK
                int "CLK GPIO number"
                range ENV_GPIO_RANGE_MIN ENV_GPIO_OUT_RANGE_MAX
                default 6
                help
                    GPIO pin number for SPI Clock.

            config SNIFFER_PIN_CS
                int "CS GPIO number"
                range ENV_GPIO_RANGE_MIN ENV_GPIO_OUT_RANGE_MAX
                default 27
                help
                    GPIO pin number for SPI Chip Select.
        endmenu
        config SNIFFER_MOUNT_POINT
            string "SD card mount point in the filesystem"
            default "/sdcard"
            help
                Specify the mount point in the VFS (Virtual File System) for SD card.
    endif
    if SNIFFER_PCAP_DESTINATION_SD
        config SNIFFER_PCAP_FILE_NAME_MAX_LEN
            int "Max name length of pcap file"
            default 32
            help
                Specify maximum name length of pcap file.
    endif

    if SNIFFER_PCAP_DESTINATION_MEMORY
        config SNIFFER_PCAP_MEMORY_SIZE
            int "Memory size of the '.pcap' file in memory"
            default 4096
            help
                Max memory size to storage packet in memory.
    endif

    config SNIFFER_WORK_QUEUE_LEN
        int "Length of sniffer work queue"
        default 128
        help
            The sniffer callback function should not do heavy work, so we put all heavy IO operation to another task.
            The task gets some basic info of sniffer packet via queue.
            Here you should specify the length of queue.

    config SNIFFER_TASK_STACK_SIZE
        int "Stack size of sniffer task"
        default 4096
        help
            Stack size of sniffer task.

    config SNIFFER_TASK_PRIORITY
        int "Priority of sniffer task"
        default 2
        help
            Priority of sniffer task.

    choice LED_TYPE
        prompt "Status LED type"
        default LED_TYPE_WS2812_STRIP
        help
            Which kind of status LED the board carries.  This used to be
            derived from the LED count, which could not express a plain
            non-addressable LED: such a board has one LED but no WS2812.

        config LED_TYPE_NONE
            bool "None"

        config LED_TYPE_GPIO
            bool "Single plain LED on a GPIO"
            help
                One non-addressable LED. No colour available, so states are
                shown as blink patterns instead.

        config LED_TYPE_WS2812_SINGLE
            bool "Single WS2812"
            help
                One addressable LED showing overall state by colour.

        config LED_TYPE_WS2812_STRIP
            bool "WS2812 strip, 5 LEDs"
            help
                One LED per subsystem: system, sniffer, network, MQTT, C-ITS.
    endchoice

    config LED_PIN
        int "Status LED GPIO"
        depends on !LED_TYPE_NONE
        range ENV_GPIO_RANGE_MIN ENV_GPIO_OUT_RANGE_MAX
        default 26
        help
            GPIO the status LED (or the strip's data line) is connected to.

    config LED_ACTIVE_LOW
        bool "Status LED is active low"
        depends on LED_TYPE_GPIO
        default n
        help
            Set when the LED is wired between VDD and the GPIO, so driving the
            pin low lights it up.  Example: NiceMCU ESP32-C5 Mini, GPIO23.

    config ENABLE_TEMPERATURE
        bool "Enable I2C temperature sensor"
        default y
endmenu

menu "SPI EPPP Configuration"
    config USE_SPI_EPPP
        bool "Use SPI EPPP for network connectivity"
        default n
        help
            Use an ESP32 running the EPPP SPI slave (NAT gateway) instead of
            a hardware Ethernet chip for IP connectivity.

    if USE_SPI_EPPP
        menu "SPI EPPP Pin Configuration"
            config SPI_EPPP_PIN_MOSI
                int "MOSI GPIO number"
                range ENV_GPIO_RANGE_MIN ENV_GPIO_OUT_RANGE_MAX
                default 5

            config SPI_EPPP_PIN_MISO
                int "MISO GPIO number"
                range ENV_GPIO_RANGE_MIN ENV_GPIO_IN_RANGE_MAX
                default 2

            config SPI_EPPP_PIN_SCLK
                int "SCLK GPIO number"
                range ENV_GPIO_RANGE_MIN ENV_GPIO_OUT_RANGE_MAX
                default 7

            config SPI_EPPP_PIN_CS
                int "CS GPIO number"
                range ENV_GPIO_RANGE_MIN ENV_GPIO_OUT_RANGE_MAX
                default 6

            config SPI_EPPP_PIN_INT
                int "Interrupt GPIO number"
                range ENV_GPIO_RANGE_MIN ENV_GPIO_IN_RANGE_MAX
                default 9
        endmenu

        config SPI_EPPP_FREQ_MHZ
            int "SPI clock frequency (MHz)"
            range 1 40
            default 16
    endif
endmenu

menu "LTE Modem Configuration"
    config USE_LTE_PPP
        bool "Use an LTE modem over PPP for network connectivity"
        depends on !USE_SPI_EPPP
        default n
        help
            Use a SIMCom A7670E on a local UART for IP connectivity, instead of
            a hardware Ethernet chip or the SPI EPPP gateway.  Needs a data SIM;
            set the APN with "config set lteapn" and, if the SIM has one, the
            PIN with "config set ltesimpin".

            The exclusion with USE_SPI_EPPP is one-way on purpose: two symbols
            each depending on the other's negation is a recursive dependency
            that Kconfig rejects, and moving USE_SPI_EPPP into a shared choice
            would mean touching all three existing sdkconfig variants.  So turn
            SPI EPPP off first.

    if USE_LTE_PPP
        config LTE_PIN_TX
            int "UART TX GPIO number (to the modem's RXD)"
            range ENV_GPIO_RANGE_MIN ENV_GPIO_OUT_RANGE_MAX
            default 8

        config LTE_PIN_RX
            int "UART RX GPIO number (from the modem's TXD)"
            range ENV_GPIO_RANGE_MIN ENV_GPIO_IN_RANGE_MAX
            default 9
            help
                Note that 9 is also the default of SPI_EPPP_PIN_INT and the INT
                pin the README documents for the Ethernet modules.  Harmless,
                since those uplinks are mutually exclusive with this one, but
                worth knowing when copying an sdkconfig together.

        config LTE_UART_TARGET_BAUD
            int "Local UART baud rate to switch the modem to"
            range 9600 921600
            default 115200
            help
                Rate of the wired UART between MCU and modem.  This is NOT the
                mobile data rate: LTE Cat 1 does 10 Mbit/s down and 5 Mbit/s up,
                far more than three jumper wires carry.  The UART is the
                bottleneck, not the network.

                The modem always comes up at its stored AT+IPREX rate (115200);
                this is the rate the firmware then switches it to with AT+IPR.
                Measured on the BKP-A7670 breakout: ~72 kbit/s at 115200,
                ~275 kbit/s at 460800, which is four times what SIMCom
                recommends for that board's two-transistor level shifter.

                Do not raise this blindly.  A rate the wiring cannot carry does
                not fail cleanly -- a four-byte AT still gets through while
                1400-byte PPP frames pick up bit errors under load.  AT+IPR is
                session-only though, so a failed experiment is undone by
                power-cycling the modem.
    endif
endmenu
```
